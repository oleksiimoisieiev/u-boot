## arch/x86/cpu/hvm/Kconfig
```kconfig
# SPDX-License-Identifier: GPL-2.0+
#
# Copyright (C) 2025, EPAM Systems

config HVM
	bool
	select ARCH_EARLY_INIT_R
	imply AHCI_PCI

if HVM

config SYS_CAR_ADDR
	hex
	default 0x10000

config SYS_CAR_SIZE
	hex
	default 0x10000

endif
```

## board/emulation/hvm-x86/Kconfig
```kconfig
if TARGET_HVM_X86_64

config SYS_BOARD
	default "hvm-x86"

config SYS_VENDOR
	default "emulation"

config SYS_SOC
	default "hvm"

config SYS_CONFIG_NAME
	default "hvm"

config TEXT_BASE
	default 0x19fa8

config BOARD_SPECIFIC_OPTIONS # dummy
	def_bool y
	select HVM
	select BOARD_ROMSIZE_KB_1024
	imply VIRTIO_PCI
	imply VIRTIO_NET
	imply VIRTIO_BLK

endif
```
